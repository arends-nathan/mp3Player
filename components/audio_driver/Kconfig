## components/audio_driver/Kconfig
```kconfig
menu "Audio Driver Configuration"

    config AUDIO_I2S_BCLK_PIN
        int "I2S bit clock (BCLK) GPIO"
        default 27
        help
            GPIO connected to the BCLK/SCK pin of the I2S DAC/amplifier
            (e.g. MAX98357A). Must not collide with the OLED I2C bus (21/22).

    config AUDIO_I2S_LRCLK_PIN
        int "I2S word select (LRCLK/WS) GPIO"
        default 26
        help
            GPIO connected to the LRC/WS pin of the I2S amplifier.

    config AUDIO_I2S_DOUT_PIN
        int "I2S data out (DIN) GPIO"
        default 25
        help
            GPIO connected to the DIN/SD data input of the I2S amplifier.

endmenu
```

## main/Kconfig.projbuild
```kconfig
# put here your custom config value
menu "Example Configuration"
config ESP_WIFI_SSID
    string "WiFi SSID"
    help
	SSID (network name) for the example to connect to.

config ESP_WIFI_PASSWORD
    string "WiFi Password"
    help
	WiFi password (WPA or WPA2) for the example to use.

config SYNC_BACKEND_URL
    string "MP3 sync backend base URL"
    default "http://192.168.1.50:8000"
    help
	Base URL of the spotify-sync HTTP API (no trailing slash). The device
	fetches "<url>/manifest" and downloads new tracks from "<url>/files/<name>".

config SYNC_LOCAL_DIR
    string "Local music directory"
    default "/sdcard"
    help
	Mount point of the SD card where downloaded MP3s are stored and played
	from. The card is accessed over SPI.
endmenu
```
